## conf/layer.conf
```bitbake
BBPATH =. "${LAYERDIR}:"

BBFILES += "${LAYERDIR}/recipes-*/*/*.bb ${LAYERDIR}/recipes-*/*/*.bbappend"

BBFILE_COLLECTIONS += "meta-mink"
BBFILE_PATTERN_meta-mink := "^${LAYERDIR}/"
BBFILE_PRIORITY_meta-mink = "26"

LAYERSERIES_COMPAT_meta-mink = "honister"

LAYERDEPENDS_meta-mink = " \
    core \
    openembedded-layer \
    networking-layer \
    meta-python \
"

LAYERVERSION_meta-mink = "3"

LAYERDEPENDS_meta-mink = "core"

REQUIRED_POKY_BBLAYERS_CONF_VERSION = "2"
```
